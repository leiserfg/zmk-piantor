## config/west.yml
```yaml
manifest:
  defaults:
    revision: v0.3
  remotes:
    - name: zmkfirmware
      url-base: https://github.com/zmkfirmware
    # Additional modules containing boards/shields/custom code can be listed here as well
    # See https://docs.zephyrproject.org/3.2.0/develop/west/manifest.html#projects
  projects:
    - name: zmk
      remote: zmkfirmware
      import: app/west.yml
    - name: zmk-keyboard-piantor
      url: https://github.com/dani0854/zmk-keyboard-piantor
      revision: main
      path: modules/zmk-keyboard-piantor
    - name: zmk-component-rpi-pico
      url: https://github.com/dani0854/zmk-component-rpi-pico
      revision: main
      path: modules/zmk-component-rpi-pico
  self:
    path: config
```
